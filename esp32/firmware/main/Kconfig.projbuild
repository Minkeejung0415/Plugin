## esp32/firmware/main/Kconfig.projbuild
```kconfig
menu "STEP ESP32-S3 Node"

config ESP_WIFI_SSID
    string "Wi-Fi SSID"
    default "STEP_ESP32"

config ESP_WIFI_PASSWORD
    string "Wi-Fi password"
    default "changeme"

config STEP_ENABLE_ESPNOW
    bool "Enable ESP-NOW multi-node sync"
    default n
    help
        Off by default. Enable when using two or more boards.
        Single-board v1 bench tests do not need ESP-NOW.

config STEP_NODE_MASTER
    bool "ESP-NOW sync master (when ESP-NOW enabled)"
    depends on STEP_ENABLE_ESPNOW
    default y

config STEP_DIO_GPIO
    int "DIO input GPIO"
    default 1

config STEP_ENABLE_SD_LOGGER
    bool "Enable SD acquisition logger"
    default y
    help
        Enables device-side SD logging. Disable for stream-only stress comparisons.

config STEP_SD_LOG_QUEUE_DEPTH
    int "SD logger queue depth"
    default 256
    range 8 4096
    help
        Number of samples the acquisition task can enqueue before SD logging reports drops.

config STEP_SD_LOG_FLUSH_INTERVAL_MS
    int "SD logger flush interval in milliseconds"
    default 1000
    range 100 60000
    help
        Periodic flush cadence for the SD writer task. Samples are not flushed from the acquisition task.

config STEP_SD_LOG_PATH
    string "SD log file path"
    default "/sdcard/step_session.bin"
    help
        Path for the binary acquisition log once /sdcard has been mounted.

endmenu
```

## esp32/firmware/sdkconfig.defaults
```kconfig
CONFIG_IDF_TARGET="esp32s3"
CONFIG_ESP_WIFI_SOFTAP_SUPPORT=n
CONFIG_FREERTOS_HZ=1000
CONFIG_ESP_MAIN_TASK_STACK_SIZE=8192
```

## esp32s3/sdkconfig.defaults
```kconfig
# Flash & PSRAM
CONFIG_ESPTOOLPY_FLASHSIZE_16MB=y
CONFIG_SPIRAM=y
CONFIG_SPIRAM_MODE_OCT=y
CONFIG_SPIRAM_SPEED_80M=y
CONFIG_SPIRAM_USE_MALLOC=y

# CPU
CONFIG_ESP_DEFAULT_CPU_FREQ_MHZ_240=y

# FreeRTOS tick rate — 1 kHz so 1-ms resolution
CONFIG_FREERTOS_HZ=1000

# Stack sizes
CONFIG_ESP_MAIN_TASK_STACK_SIZE=8192

# WiFi
CONFIG_ESP_WIFI_STATIC_RX_BUFFER_NUM=16
CONFIG_ESP_WIFI_DYNAMIC_RX_BUFFER_NUM=32
CONFIG_ESP_WIFI_TX_BUFFER_TYPE_STATIC=y
CONFIG_ESP_WIFI_STATIC_TX_BUFFER_NUM=16

# lwIP — larger socket buffers for UDP burst
CONFIG_LWIP_UDP_RECVMBOX_SIZE=64
CONFIG_LWIP_TCP_RECVMBOX_SIZE=64
CONFIG_LWIP_TCPIP_RECVMBOX_SIZE=128

# Log level
CONFIG_LOG_DEFAULT_LEVEL_INFO=y

# SDMMC
CONFIG_SOC_SDMMC_HOST_SUPPORTED=y

# Partition table
CONFIG_PARTITION_TABLE_CUSTOM=y
CONFIG_PARTITION_TABLE_CUSTOM_FILENAME="partitions.csv"
```
